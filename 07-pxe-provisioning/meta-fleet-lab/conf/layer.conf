## 07-pxe-provisioning/meta-fleet-lab/conf/layer.conf
```bitbake
BBPATH .= ":${LAYERDIR}"
BBFILES += "${LAYERDIR}/recipes-*/*/*.bb ${LAYERDIR}/recipes-*/*/*.bbappend"

BBFILE_COLLECTIONS += "fleet-lab"
BBFILE_PATTERN_fleet-lab = "^${LAYERDIR}/"
BBFILE_PRIORITY_fleet-lab = "10"

LAYERDEPENDS_fleet-lab = "core"
LAYERSERIES_COMPAT_fleet-lab = "scarthgap"

WKS_SEARCH_PATH:prepend = "${LAYERDIR}/wic:"

# Maintainer: David Bensoussan, https://github.com/Minipada/robot-fleet-lab
```
